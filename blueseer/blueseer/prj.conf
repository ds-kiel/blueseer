## CMakeLists.txt
```
# SPDX-License-Identifier: Apache-2.0

cmake_minimum_required(VERSION 3.13.1)
set(SHIELD ssd1306_128x32)
find_package(Zephyr REQUIRED HINTS $ENV{ZEPHYR_BASE})
project(external_lib)



FILE(GLOB app_sources src/*.cc)
target_sources(app PRIVATE ${app_sources})

zephyr_include_directories(src)
zephyr_library_include_directories(${ZEPHYR_BASE}/samples/bluetooth)

#zephyr_cc_option(-lstdc++)

# The external static library that we are linking with does not know
# how to build for this platform so we export all the flags used in
# this zephyr build to the external build system.
#
# Other external build systems may be self-contained enough that they
# do not need any build information from zephyr. Or they may be
# incompatible with certain zephyr options and need them to be
# filtered out.



list(GET ZEPHYR_RUNNER_ARGS_jlink 1 MCPU_FLAG ) #Here we assume that '-mcpu' will be the second argument. This might be wrong. 
string(REPLACE "=" ";" MCPU_FLAG_LIST ${MCPU_FLAG})
list(GET MCPU_FLAG_LIST 0 MCPU)

set(TARGET cortex_m_generic) #set(TARGET ${BOARD})
set(TARGET_ARCH cortex-m4)

set(TF_SRC_DIR /Users/valentin/research/toolchains/tflite-micro) #path to folder containing tensorflow
set(TF_MAKE_DIR ${TF_SRC_DIR}/tensorflow/lite/micro/tools/make)
set(TF_LIB_DIR ${TF_MAKE_DIR}/gen/${TARGET}_${TARGET_ARCH}_default/lib)
set(extra_project_flags "-mcpu=${TARGET_ARCH} -mthumb -mno-thumb-interwork -mfpu=fpv5-sp-d16 -mfloat-abi=softfp") #I had to remove -DTF_LITE_STATIC_MEMORY to make hello_world run. 

zephyr_get_include_directories_for_lang_as_string(       C C_includes)
zephyr_get_system_include_directories_for_lang_as_string(C C_system_includes)
zephyr_get_compile_definitions_for_lang_as_string(       C C_definitions)
zephyr_get_compile_options_for_lang_as_string(           C C_options)

set(external_project_cflags
  "${C_includes} ${C_definitions} ${optC_optionsions} ${C_system_includes} ${extra_project_flags} -DCMSIS_NN"
)

zephyr_get_include_directories_for_lang_as_string(       CXX CXX_includes)
zephyr_get_system_include_directories_for_lang_as_string(CXX CXX_system_includes)
zephyr_get_compile_definitions_for_lang_as_string(       CXX CXX_definitions)
zephyr_get_compile_options_for_lang_as_string(           CXX CXX_options)


set(external_project_cxxflags
  "${CXX_includes} ${CXX_definitions} ${CXX_options} ${CXX_system_includes} ${extra_project_flags} -DCMSIS_NN"
)

include(ExternalProject)

# Add an external project to be able download and build the third
# party library. In this case downloading is not necessary as it has
# been committed to the repository.




set(submake gmake)

ExternalProject_Add(
  tf_project                 # Name for custom target
  #PREFIX     ${mylib_build_dir} # Root dir for entire project
  SOURCE_DIR ${TF_SRC_DIR}
  BINARY_DIR ${TF_SRC_DIR} # This particular build system is invoked from the root
  CONFIGURE_COMMAND ""    # Skip configuring the project, e.g. with autoconf
  BUILD_COMMAND
  ${submake} -f tensorflow/lite/micro/tools/make/Makefile
  TARGET=${TARGET}
  TARGET_ARCH=${TARGET_ARCH}
  OPTIMIZED_KERNEL_DIR=cmsis_nn
  TARGET_TOOLCHAIN_ROOT=${GNUARMEMB_TOOLCHAIN_PATH}/bin/
  TARGET_TOOLCHAIN_PREFIX=arm-none-eabi-
  #PREFIX=${mylib_build_dir}
  CC=${CMAKE_C_COMPILER}
  CXX=${CMAKE_CXX_COMPILER}
  AR=${CMAKE_AR}
  CCFLAGS=${external_project_cflags} 
  CXXFLAGS=${external_project_cxxflags} 
  microlite 
  INSTALL_COMMAND ""      # This particular build system has no install command
  BUILD_BYPRODUCTS ${TF_LIB_DIR}/libtensorflow-microlite.a
  )

# Create a wrapper CMake library that our app can link with
add_library(tf_lib STATIC IMPORTED GLOBAL)

add_dependencies(
  tf_lib
  tf_project
  )
set_target_properties(tf_lib PROPERTIES IMPORTED_LOCATION             ${TF_LIB_DIR}/libtensorflow-microlite.a)
set_target_properties(tf_lib PROPERTIES INTERFACE_INCLUDE_DIRECTORIES "${TF_SRC_DIR};${TF_SRC_DIR}/tensorflow/lite/micro;${TF_MAKE_DIR}/downloads/flatbuffers/include") 

#zephyr_include_directories(
#  ${GNUARMEMB_TOOLCHAIN_PATH}/arm-none-eabi/include/
#  ${GNUARMEMB_TOOLCHAIN_PATH}/arm-none-eabi/include/c++/9.2.1
#  ${GNUARMEMB_TOOLCHAIN_PATH}/arm-none-eabi/include/c++/9.2.1/arm-none-eabi
#)


target_link_libraries(app PUBLIC tf_lib)
```

## prj.conf
```kconfig
CONFIG_CPLUSPLUS=y
CONFIG_STD_CPP11=y
CONFIG_NEWLIB_LIBC=y
CONFIG_FPU=y
CONFIG_FP_SOFTABI=y
CONFIG_LIB_CPLUSPLUS=y


CONFIG_HEAP_MEM_POOL_SIZE=16384
CONFIG_MAIN_STACK_SIZE=8192
CONFIG_SYSTEM_WORKQUEUE_STACK_SIZE=8192

CONFIG_PWM=y

CONFIG_LOG=n
CONFIG_GPIO=y
CONFIG_UART_CONSOLE=n

#enabale RTT logging
CONFIG_USE_SEGGER_RTT=y
CONFIG_RTT_CONSOLE=y
CONFIG_LOG_PRINTK=y

CONFIG_DISPLAY=y
CONFIG_DISPLAY_LOG_LEVEL_ERR=y

CONFIG_BT=y
CONFIG_BT_BROADCASTER=y
CONFIG_BT_OBSERVER=y
CONFIG_BT_DEBUG_LOG=y

CONFIG_LVGL=y
CONFIG_LVGL_USE_LABEL=y
CONFIG_LVGL_USE_CONT=y
CONFIG_LVGL_USE_BTN=y
CONFIG_LVGL_USE_THEME_MATERIAL=y

CONFIG_DISK_ACCESS=y
CONFIG_FILE_SYSTEM=y
CONFIG_FAT_FILESYSTEM_ELM=y
```

## src/blueseer.cc
```c
/*
Using a predefined neural network we predict the environment to a given data sample.
*/

#include "module_config.h"

#ifdef WITH_CLASSIFICATION

#include "blueseer.h"

#include "tensorflow/lite/micro/micro_mutable_op_resolver.h"
#include "blueseer_model.h"
#include "tensorflow/lite/micro/micro_error_reporter.h"
#include "tensorflow/lite/micro/micro_interpreter.h"
#include "tensorflow/lite/schema/schema_generated.h"
//#include "tensorflow/lite/version.h"
#include <sys/printk.h>
#include <math.h>

#include <zephyr.h>

#define DATA_LINE_LENGTH 23
#define DATA_ROWS 5

static float normalized_vector[DATA_LINE_LENGTH*DATA_ROWS];


namespace
{
tflite::ErrorReporter *error_reporter = nullptr;
const tflite::Model *model = nullptr;
tflite::MicroInterpreter *interpreter = nullptr;
TfLiteTensor *input = nullptr;
TfLiteTensor *output = nullptr;

// Create an area of memory to use for input, output, and intermediate arrays.
// const int kModelArenaSize = 6064;
// Extra headroom for model + alignment + future interpreter changes.
// const int kExtraArenaSize = 560 + 16 + 160;
const int kTensorArenaSize = 2048; //kModelArenaSize + kExtraArenaSize;
static uint8_t tensor_arena[kTensorArenaSize];
} 

/*
normalize data sample; must be done since neural network is trained with normalized data
*/
void normalize_input(int raw_vector[], int length, float *normalized_vector)
{
	for (int i = 0; i < length; i++) {
		normalized_vector[i] = (raw_vector[i] - mean_list[i]) / std_list[i];
	}
}

/*
initialize neural network
*/
void blueseer_setup()
{

	static tflite::MicroErrorReporter micro_error_reporter;
	error_reporter = &micro_error_reporter;

	model = tflite::GetModel(blueseer_model);

	if (model->version() != TFLITE_SCHEMA_VERSION) {
		#ifdef WITH_LOGGING
		TF_LITE_REPORT_ERROR(error_reporter,
				     "Model provided is schema version %d not equal "
				     "to supported version %d.",
				     model->version(), TFLITE_SCHEMA_VERSION);
		printk("model not supported\n");
		#endif /* WITH_LOGGING */
		return;
	}

	//static tflite::AllOpsResolver resolver;
	static tflite::MicroMutableOpResolver<5> resolver;
	resolver.AddFullyConnected();
	resolver.AddSoftmax();
	resolver.AddRelu();
	resolver.AddQuantize();
	resolver.AddDequantize();

	// Build an interpreter to run the model with.
	static tflite::MicroInterpreter static_interpreter(model, resolver, tensor_arena,
							   kTensorArenaSize, error_reporter);
	interpreter = &static_interpreter;

	// Allocate memory from the tensor_arena for the model's tensors.
	TfLiteStatus allocate_status = interpreter->AllocateTensors();

	if (allocate_status != kTfLiteOk) {
		#ifdef WITH_LOGGING
		TF_LITE_REPORT_ERROR(error_reporter, "AllocateTensors() failed");
		printk("tensor allocation failed\n");
		#endif /* WITH_LOGGING */
		return;
	}

	// Obtain pointers to the model's input and output tensors.
	input = interpreter->input(0);
	output = interpreter->output(0);

	//print expected and actual input size and used memory 
	int expected = input->dims->data[1];
	#ifdef WITH_LOGGING
	printk("sample input: %d, expected input: %d, used tensor bytes: %d\n", DATA_LINE_LENGTH*DATA_ROWS, expected, interpreter->arena_used_bytes());
	#endif /* WITH_LOGGING */
}

/*
predict data sample with pretrained neural network
*/
void blueseer_infer(int data_sample[DATA_LINE_LENGTH*DATA_ROWS], struct classification *ptr)
{

	normalize_input(data_sample, DATA_LINE_LENGTH*DATA_ROWS, normalized_vector);

	for (int i = 0; i < DATA_LINE_LENGTH*DATA_ROWS; i++) {
		input->data.f[i] = normalized_vector[i];
	}

	//execute network
	interpreter->Invoke();
	float max_value = 0;
	int env_index_pred = -1;

	//find environment with highest probability
	for (int i = 0; i<available_env_len; i++){
		float pred = output->data.f[i];
		if( pred> max_value){
			max_value = pred;
			env_index_pred = i;
		}
	}
			#ifdef WITH_LOGGING
			printk("Pred: ");
			for (int i=0;i<7;++i){
				printk("%i->%i.%i; ", i, (int) (output->data.f[i]*100), ((int)(output->data.f[i]*10000))%100);
			}
			printk("\n");
			#endif /* WITH_LOGGING */
	

	ptr->index = env_index_pred;
	ptr->probability = max_value;
}

#endif /* WITH_CLASSIFICIATION */
```

## src/blueseer.h
```c
#ifndef TENSORFLOW_LITE_MICRO_EXAMPLES_HELLO_WORLD_MAIN_FUNCTIONS_H_
#define TENSORFLOW_LITE_MICRO_EXAMPLES_HELLO_WORLD_MAIN_FUNCTIONS_H_


#ifdef __cplusplus
extern "C" {
#endif

//Used to pass classification output of neural network
struct classification {
	int index;
	float probability;
};
// Initialize neural network
void blueseer_setup();

// Predict environment of given data sample
void blueseer_infer(int data_sample[230], struct classification *ptr);

#ifdef __cplusplus
}
#endif

#endif 
```

## src/blueseer_model.h
```c
/*
Contains the environments to classify between, mean and std values for normalization and the pretrained neural network model.
*/


#ifndef TENSORFLOW_LITE_MICRO_EXAMPLES_HELLO_WORLD_CONSTANTS_H_
#define TENSORFLOW_LITE_MICRO_EXAMPLES_HELLO_WORLD_CONSTANTS_H_

//environments that can be detected by the neural network
extern const char available_env[][16];
extern const int available_env_len;

//mean and std values for all features to normalize input data (not shared between scans)
extern const float mean_list[115];
extern const float std_list[115];

//pre trained neural network
extern const unsigned char blueseer_model[];
extern const int blueseer_model_len;

#endif 
```

## src/display.cc
```c
#include "module_config.h"

#ifdef WITH_DISPLAY
#include "display.h"
#include <drivers/display.h>
#include <lvgl.h>

//display
const struct device *display_dev;
static lv_obj_t *text;
static bool display_initalized;

	/*
	setup display and clear screen
	*/
	void initDisplay()
	{
		display_dev = device_get_binding(CONFIG_LVGL_DISPLAY_DEV_NAME);

		if (display_dev == NULL) {
			#ifdef WITH_LOGGING
			printk("device not found.\n");
			#endif /* WITH_LOGGING */
			return;
		}

		if (IS_ENABLED(CONFIG_LVGL_POINTER_KSCAN)) {
			lv_obj_t *hello_world_button;

			hello_world_button = lv_btn_create(lv_scr_act(), NULL);
			lv_obj_align(hello_world_button, NULL, LV_ALIGN_CENTER, 0, 0);
			lv_btn_set_fit(hello_world_button, LV_FIT_TIGHT);
			text = lv_label_create(hello_world_button, NULL);
		} else {
			text = lv_label_create(lv_scr_act(), NULL);
		}

		lv_label_set_text(text, "");
		lv_obj_align(text, NULL, LV_ALIGN_CENTER, 0, 0);

		lv_task_handler();
		display_blanking_off(display_dev);

		display_initalized = true;
	}

	/*
	set text shown on display to txt
	*/
	void setDisplayText(char *txt)
	{
		if (text != NULL && display_initalized) {
			lv_label_set_text(text, txt);
			lv_obj_align(text, NULL, LV_ALIGN_CENTER, 0, 0);

			lv_task_handler();
		}
	}


#endif /* WITH_DISPLAY */
```

## src/display.h
```c
#ifdef __cplusplus
extern "C" {
#endif

void initDisplay();
void setDisplayText(char *txt);

#ifdef __cplusplus
}
#endif
```

## src/module_config.h
```c
// macros to turn off certain functionalities: comment out to disable functionality
#define WITH_CLASSIFICATION 1 // when commented out: data collection only
#define WITH_DISPLAY 1
#define WITH_SD 1
#define WITH_BUTTONS 1
#define WITH_LOGGING 1
#define WITH_PARSING 1
```

## src/storage.cc
```c
// #include "module_config.h"

// #ifdef WITH_SD
// #include <storage/disk_access.h>
// #include <fs/fs.h>
// #include <ff.h>
// #include <string.h>
// #ifdef WITH_DISPLAY
//     #include "display.h"
// #endif /* WITH_DISPLAY */

// 	//SD-Card
// 	static FATFS fat_fs;
// 	/* mounting info */
//     static struct fs_mount_t mp = {
// 		.type = FS_FATFS,
// 		.fs_data = &fat_fs,
// 	};
// 	const char *disk_mount_pt = "/SD:";
// 	const char *dataPath = "/ble_data";
// 	const char *evalPath = "/eval";
// 	bool sd_card_initialized = false;

//     /*
// 	get number of files in dir at given path
// 	*/
// 	int get_file_count(const char *path)
// 	{
// 		int res;
// 		struct fs_dir_t dirp;
// 		static struct fs_dirent entry;

// 		fs_dir_t_init(&dirp);

// 		res = fs_opendir(&dirp, path);
// 		if (res) {
// 			#ifdef WITH_LOGGING
// 			printk("Error opening dir %s [%d]\n", path, res);
// 			#endif /* WITH_LOGGING */
// 			return -1;
// 		}

// 		int files = 0;
// 		for (;;) {
// 			res = fs_readdir(&dirp, &entry);

// 			if (res || entry.name[0] == 0) {
// 				break;
// 			}

// 			if (entry.type != FS_DIR_ENTRY_DIR) {
// 				files++;
// 			}
// 		}

// 		fs_closedir(&dirp);

// 		return files;
// 	}

// 	/*
// 	creates dir at given path if path exists
// 	*/
// 	int createDir(const char *path)
// 	{
// 		struct fs_dir_t dir_data;

// 		fs_dir_t_init(&dir_data);

// 		int dir_err = fs_opendir(&dir_data, path);
// 		//check if dir already exists at path
// 		if (dir_err) {
// 			fs_mkdir(path);
// 			#ifdef WITH_LOGGING
// 			printk("created dir: %s\n", path);
// 			#endif /* WITH_LOGGING */
// 		}
// 		fs_closedir(&dir_data);

// 		return get_file_count(path);
// 	}

// 	/*
// 	setup SD-card and create dirs to save data samples in
// 	*/
// 	void initSDCard()
// 	{
// 		do {
// 			static const char *disk_pdrv = "SD";
// 			uint64_t memory_size_mb;
// 			uint32_t block_count;
// 			uint32_t block_size;

// 			if (disk_access_init(disk_pdrv) != 0) {
// 				#ifdef WITH_LOGGING
// 				printk("Storage init ERROR!");
// 				#endif /* WITH_LOGGING */
// 				break;
// 			}

// 			if (disk_access_ioctl(disk_pdrv, DISK_IOCTL_GET_SECTOR_COUNT, &block_count)) {
// 				#ifdef WITH_LOGGING
// 				printk("Unable to get sector count");
// 				#endif /* WITH_LOGGING */
// 				break;
// 			}
// 			#ifdef WITH_LOGGING
// 			printk("Block count %u", block_count);
// 			#endif /* WITH_LOGGING */

// 			if (disk_access_ioctl(disk_pdrv, DISK_IOCTL_GET_SECTOR_SIZE, &block_size)) {
// 				#ifdef WITH_LOGGING
// 				printk("Unable to get sector size");
// 				#endif /* WITH_LOGGING */
// 				break;
// 			}
// 			#ifdef WITH_LOGGING
// 			printk("Sector size %u\n", block_size);
// 			#endif /* WITH_LOGGING */

// 			memory_size_mb = (uint64_t)block_count * block_size;
// 			#ifdef WITH_LOGGING
// 			printk("Memory Size(MB) %u\n", (uint32_t)(memory_size_mb >> 20));
// 			#endif /* WITH_LOGGING */
// 		} while (0);

// 		mp.mnt_point = disk_mount_pt;

// 		int res = fs_mount(&mp);

// 		if (res == FR_OK) {
// 			#ifdef WITH_LOGGING
// 			printk("Disk mounted.\n");
// 			#endif /* WITH_LOGGING */

// 		} else {
// 			#ifdef WITH_LOGGING
// 			printk("Error mounting disk.\n");
// 			#endif /* WITH_LOGGING */
// 			return;
// 		}

// 		//create dirs for data samples, eval data and times of the day

// 		char data_path[50];
// 		strcpy(data_path, disk_mount_pt);
// 		strcat(data_path, dataPath);

// 		char eval_path[50];
// 		strcpy(eval_path, disk_mount_pt);
// 		strcat(eval_path, evalPath);

// 		#ifdef WITH_LOGGING
// 		printk("files in %s: %d\n", data_path, createDir(data_path));
// 		printk("files in %s: %d\n", eval_path, createDir(eval_path));
// 		#endif /* WITH_LOGGING */

// 		for (int i = 0; i < DAYTIME_COUNT; i++) {
// 			char dir_day_path[50];
// 			strcpy(dir_day_path, eval_path);
// 			strcat(dir_day_path, "/");
// 			strcat(dir_day_path, daytimes[i]);

// 			createDir(dir_day_path);

// 			char dir_day_data_path[50];
// 			strcpy(dir_day_data_path, data_path);
// 			strcat(dir_day_data_path, "/");
// 			strcat(dir_day_data_path, daytimes[i]);

// 			createDir(dir_day_data_path);
// 		}

// 		sd_card_initialized = true;
// 	}

// 	/*
// 	check if file at given path exists
// 	return >=0 if file exists
// 	*/
// 	int fileExists(struct fs_file_t *file, char *path)
// 	{
// 		fs_file_t_init(file);
// 		int rc;
// 		rc = fs_open(file, path, FS_O_RDWR);
// 		if (rc >= 0) {
// 			fs_close(file);
// 		}

// 		return rc;
// 	}

// 	/*
// 	open or create file at given path
// 	*/
// 	int openOrCreateFile(struct fs_file_t *file, char *path)
// 	{
// 		fs_file_t_init(file);
// 		int rc;
// 		rc = fs_open(file, path, FS_O_CREATE | FS_O_RDWR);
// 		#ifdef WITH_LOGGING
// 		if (rc < 0 && rc != -2) {
// 			//error while creating/opening file
// 			printk("FAIL: open %s: %d\n", path, rc);
// 		}
// 		#endif /* WITH_LOGGING */

// 		return rc;
// 	}

// 	/*
// 	search for file name that doesnt exist (by increasing index number)
// 	write data sample string (data_str) to CSV file
// 	*/
// 	void writeDataFile()
// 	{
// 		struct fs_file_t dataFile;

// 		int rc;

// 		char filePath[100];

// 		//create directory if new experiment started
// 		if (strcmp(current_dir, "") == 0){
// 			unsigned int dir_count = 0;
// 			while (1) {
// 				char current_env_str[20];
// 				strcpy(current_env_str, environments[current_environment]);

// 				char first[2];
// 				sprintf(first, "%c", current_env_str[0]);

// 				char second[2];
// 				sprintf(second, "%c", current_env_str[1]);

// 				char count_str[20];
// 				sprintf(count_str, "/%s%s%d.csv", first, second, dir_count);

// 				char dataDirPath[50];
// 				strcpy(dataDirPath, disk_mount_pt);
// 				strcat(dataDirPath, dataPath);	
// 				strcat(dataDirPath, "/");
// 				strcat(dataDirPath, daytimes[current_daytime]);
// 				strcat(dataDirPath, count_str);

// 				#ifdef WITH_LOGGING
// 				printk("data dir path: %s\n", dataDirPath);
// 				#endif /* WITH_LOGGING */

// 				struct fs_dir_t dir_data;

// 				fs_dir_t_init(&dir_data);

// 				int dir_err_data = fs_opendir(&dir_data, dataDirPath);
// 				#ifdef WITH_CLASSIFICATION
				
// 					char evalDirPath[50];
// 					strcpy(evalDirPath, disk_mount_pt);
// 					strcat(evalDirPath, evalPath);	
// 					strcat(evalDirPath, "/");
// 					strcat(evalDirPath, daytimes[current_daytime]);
// 					strcat(evalDirPath, count_str);

// 					#ifdef WITH_LOGGING
// 					printk("eval dir path: %s\n", evalDirPath);
// 					#endif /* WITH_LOGGING */

// 					struct fs_dir_t dir_eval;

// 					fs_dir_t_init(&dir_eval);

// 					int dir_err_eval = fs_opendir(&dir_eval, evalDirPath);
// 					//check if dir already exists at path
// 					if (dir_err_data && dir_err_eval) {
// 						fs_mkdir(dataDirPath);
// 						fs_mkdir(evalDirPath);
// 						#ifdef WITH_LOGGING
// 						printk("created dir: %s\n", dataDirPath);
// 						printk("created dir: %s\n", evalDirPath);
// 						#endif /* WITH_LOGGING */
// 						strcpy(current_dir, count_str);
// 						fs_closedir(&dir_data);
// 						fs_closedir(&dir_eval);
// 						break;
// 					}
// 					fs_closedir(&dir_eval);

// 				#else
// 					//check if dir already exists at path
// 					if (dir_err_data) {
// 						fs_mkdir(dataDirPath);
// 						#ifdef WITH_LOGGING
// 						printk("created dir: %s\n", dataDirPath);
// 						#endif /* WITH_LOGGING */
// 						strcpy(current_dir, count_str);
// 						fs_closedir(&dir_data);
// 						break;
// 					}
// 				#endif /* WITH_CLASSIFICATION */
// 				fs_closedir(&dir_data);

// 				dir_count++;
// 			}
// 		}

// 		#if !defined(WITH_CLASSIFICATION) && defined(WITH_DISPLAY)
// 		setDisplayText("Saving...");
// 		#endif /* !WITH_CLASSIFICATION && WITH_DISPLAY */

// 		//find file name that doesnt exist
// 		while (1) {
// 			char current_env_str[20];
// 			strcpy(current_env_str, environments[current_environment]);

// 			char first[2];
// 			sprintf(first, "%c", current_env_str[0]);

// 			char second[2];
// 			sprintf(second, "%c", current_env_str[1]);

// 			char count_str[20];
// 			sprintf(count_str, "/%s%s%d.csv", first, second, data_file_count);

// 			char dataFilePath[50];
// 			strcpy(dataFilePath, disk_mount_pt);
// 			strcat(dataFilePath, dataPath);	
// 			strcat(dataFilePath, "/");
// 			strcat(dataFilePath, daytimes[current_daytime]);
// 			strcat(dataFilePath, "/");
// 			strcat(dataFilePath, current_dir);
// 			strcat(dataFilePath, count_str);

// 			#ifdef WITH_LOGGING
// 			printk("data file path: %s\n", dataFilePath);
// 			#endif /* WITH_LOGGING */

// 			rc = fileExists(&dataFile, dataFilePath);

// 			if (rc == -2) {
// 				rc = openOrCreateFile(&dataFile, dataFilePath);
// 				fs_seek(&dataFile, 0, FS_SEEK_SET);
// 				strcpy(filePath, dataFilePath);
// 				data_file_count++;
// 				break;
// 			}

// 			data_file_count++;
// 		}
		

// 		fs_write(&dataFile, data_str, strlen(data_str) * sizeof(char));
// 		fs_sync(&dataFile);

// 		fs_close(&dataFile);

// 		static struct fs_dirent entry;
// 		fs_stat(filePath, &entry);
// 		#ifdef WITH_LOGGING
// 		printk("created [FILE] %s (size = %zu)\n", entry.name, entry.size);
// 		#endif /* WITH_LOGGING */
// 		#if !defined(WITH_CLASSIFICATION) && defined(WITH_DISPLAY)
// 		setDisplayText("Scanning...");
// 		#endif /* !WITH_CLASSIFICATION && WITH_DISPLAY */
// 	}

//     void sd_unmount(void) {
//         fs_unmount(&mp);
//     }

//     void write_to_file(struct fs_file_t* env_file, char* data) {
//         fs_seek(env_file, 0, FS_SEEK_END);
//         fs_write(env_file, data, strlen(data) * sizeof(char));
//         fs_sync(env_file);
//         fs_close(env_file);
//     }

//     const char* get_disk_mount_pt() {
//         return disk_mount_pt;
//     }
//     const char* get_data_path() {
//         return dataPath;
//     }
//     const char* get_eval_path() {
//         return evalPath;
//     }


// #endif /* WITH_SD */
```

## src/storage.h
```c
// #ifdef __cplusplus
// extern "C" {
// #endif



// int get_file_count(const char *path);
// int createDir(const char *path);
// void initSDCard();
// int fileExists(struct fs_file_t *file, char *path);
// int openOrCreateFile(struct fs_file_t *file, char *path);
// void writeDataFile();
// void sd_unmount(void);
// void write_to_file(struct fs_file_t* env_file, char* data);
//     const char* get_disk_mount_pt();
//     const char* get_data_path();
//     const char* get_eval_path();

// #ifdef __cplusplus
// }
// #endif
```
